## conf/layer.conf
```bitbake
# Layer configuration for meta-config

BBPATH .= ":${LAYERDIR}"
BBFILES += "${LAYERDIR}/recipes-*/*/*.bb \
            ${LAYERDIR}/recipes-*/*/*.bbappend"

BBFILE_COLLECTIONS += "config"
BBFILE_PATTERN_config = "^${LAYERDIR}/"
BBFILE_PRIORITY_config = "6"
```

## recipes-core/busybox/busybox/defconfig
```kconfig
CONFIG_UDHCPC=y
CONFIG_UDHCPC_DEFAULT_SCRIPT="/usr/share/udhcpc/default.script"
CONFIG_UDHCPC_SLACK_FOR_BUGGY_SERVERS=80
CONFIG_FEATURE_UDHCPC_ARPING=y
CONFIG_FEATURE_UDHCPC_SANITIZEOPT=y
```
